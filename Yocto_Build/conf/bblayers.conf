## Yocto_Build/conf/bblayers.conf
```bitbake
# POKY_BBLAYERS_CONF_VERSION is increased each time build/conf/bblayers.conf
# changes incompatibly
POKY_BBLAYERS_CONF_VERSION = "2"

BBPATH = "${TOPDIR}"
BBFILES ?= ""

BBLAYERS ?= " \
  ${TOPDIR}/../meta \
  ${TOPDIR}/../meta-poky \
  ${TOPDIR}/../meta-yocto-bsp \
  ${TOPDIR}/../meta-openembedded/meta-oe \
  ${TOPDIR}/../meta-qt5 \
  ${TOPDIR}/../meta-raspberrypi \
  ${TOPDIR}/../meta-mod \
  /home/hanli/Hanli/Yocto_Build/poky/build/workspace \
  "
```

## Yocto_Build/meta-mod/conf/layer.conf
```bitbake
BBPATH .= ":${LAYERDIR}"

BBFILES += "${LAYERDIR}/recipes*/*/*.bb \
            ${LAYERDIR}/recipes*/*/*.bbappend"

BBFILE_COLLECTIONS += "mod"
BBFILE_PATTERN_mod := "^${LAYERDIR}/"
BBFILE_PRIORITY_mod = "20"

LAYERSERIES_COMPAT_mod = "dunfell"
LAYERDEPENDS_mod = "core raspberrypi"

BBFILES += "${@' '.join('${LAYERDIR}/dynamic-layers/%s/recipes*/*/*.bbappend' % layer \
               for layer in BBFILE_COLLECTIONS.split())}"
BBFILES += "${@' '.join('${LAYERDIR}/dynamic-layers/%s/recipes*/*/*.bb' % layer \
               for layer in BBFILE_COLLECTIONS.split())}"

BBFILES_DYNAMIC += " \
    openembedded-layer:${LAYERDIR}/dynamic-layers/openembedded-layer/*/*/*.bb \
"
```

## ili9341_driver/Kconfig
```kconfig
config FB_ILI9341
    tristate "ILI9341 TFT LCD Driver"
    depends on FB && SPI
    help
      Say Y here if you want support for the ILI9341 SPI display driver.
```

## mgpio/Kconfig
```kconfig
# drivers/mgpio/Kconfig
config MGPIO_BUTTON
    tristate "Raspberry Pi GPIO Button Driver"
    depends on INPUT && GPIOLIB && OF
    help
      Say Y here to enable support for GPIO-based buttons on Raspberry Pi as input devices.
```
